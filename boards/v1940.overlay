/ {
    chosen {
        zmk,keyboard = &keypad;
    };

    keypad: keypad {
        compatible = "zmk,matrix-transform";
        label = "Handwired Numpad Matrix";

        rows = <6>;
        columns = <4>;

        input-gpios = <&gpio0 2 GPIO_ACTIVE_LOW>,  // row0
                      <&gpio0 3 GPIO_ACTIVE_LOW>,  // row1
                      <&gpio0 4 GPIO_ACTIVE_LOW>,  // row2
                      <&gpio0 5 GPIO_ACTIVE_LOW>,  // row3
                      <&gpio0 6 GPIO_ACTIVE_LOW>,  // row4
                      <&gpio0 7 GPIO_ACTIVE_LOW>;  // row5

        output-gpios = <&gpio1 0 GPIO_ACTIVE_LOW>, // col0
                       <&gpio1 1 GPIO_ACTIVE_LOW>, // col1
                       <&gpio1 2 GPIO_ACTIVE_LOW>, // col2
                       <&gpio1 3 GPIO_ACTIVE_LOW>; // col3
    };
};
