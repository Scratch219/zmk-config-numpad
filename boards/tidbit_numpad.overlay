#include <behaviors.dtsi>
#include <dt-bindings/zmk/keys.h>
#include <dt-bindings/zmk/bt.h>
#include <dt-bindings/zmk/outputs.h>

/* Aktiviere den Encoder oben rechts */
&encoder_4 {
    status = "okay";
};

/* Füge den Encoder zur Sensorliste hinzu */
&sensors {
    sensors = <&encoder_4>;
};
